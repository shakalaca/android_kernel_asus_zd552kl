
qcom,2902715_asus_phoenixcos_2900mah_averaged_masterslave_may17th2017_430 {
	/* # 2902715_Asus_PhoenixCos_2900mAh_averaged_MasterSlave_May17th2017*/
	qcom,max-voltage-uv = <4300000>;
	qcom,fg-cc-cv-threshold-mv = <4270>;
	qcom,nom-batt-capacity-mah = <2900>;
	qcom,batt-id-kohm = <100>;
	qcom,battery-beta = <3380>;
	qcom,battery-type = "asus_phoenix_2900mah_100k_430";
	qcom,chg-rslow-comp-c1 = <3462340>;
	qcom,chg-rslow-comp-c2 = <6179207>;
	qcom,chg-rs-to-rslow = <791547>;
	qcom,chg-rslow-comp-thr = <0xB8>;
	qcom,checksum = <0x8E04>;
	qcom,gui-version = "PMI8950GUI - 2.0.0.16";
	qcom,fg-profile-data = [
		 E9 83 F1 7C 
		 E5 80 C7 76 
		 57 83 5F 5D 
		 B8 81 CB 8C 
		 33 82 8D 99 
		 82 BC F9 C8 
		 5B 0E F8 83 
		 FE 7C C9 80 
		 64 76 51 83 
		 65 6A 6F 78 
		 05 86 38 82 
		 2D 9A 7F BD 
		 A1 CA 5B 0D 
		 00 0B E2 59 
		 D3 6D 29 FC 
		 B2 3F 29 3D 
		 E6 39 00 00 
		 86 45 45 32 
		 FE 2A 00 00 
		 00 00 00 00 
		 00 00 00 00 
		 17 6B 27 6A 
		 00 64 CA 7A 
		 DF 6F 05 63 
		 28 60 47 7A 
		 25 6E AF 60 
		 65 77 7C A1 
		 1E D8 61 21 
		 5F A0 71 0C 
		 28 00 FF 36 
		 F0 11 30 03 
		 00 00 00 0C 
	];
};
